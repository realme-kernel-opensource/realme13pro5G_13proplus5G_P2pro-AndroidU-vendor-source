&mdss_mdp {
	dsi_oplus_virtual_video: qcom,mdss_dsi_oplus_virtual_video {
		qcom,mdss-dsi-panel-name = "virtual video mode panel";
		oplus,mdss-dsi-vendor-name = "ILI7838A";
		oplus,mdss-dsi-manufacture = "TMAB727";
		qcom,mdss-dsi-panel-type = "dsi_video_mode";
		qcom,mdss-dsi-virtual-channel-id = <0>;
		qcom,mdss-dsi-stream = <0>;
		qcom,mdss-dsi-bpp = <30>;
		qcom,mdss-dsi-color-order = "rgb_swap_rgb";
		qcom,mdss-dsi-underflow-color = <0xff>;
		qcom,mdss-dsi-border-color = <0>;
		qcom,dsi-ctrl-num = <0>;
		qcom,dsi-phy-num = <0>;
		qcom,mdss-dsi-traffic-mode = "non_burst_sync_event";
		qcom,mdss-dsi-lane-map = "lane_map_0123";
		qcom,mdss-dsi-bllp-eof-power-mode;
		qcom,mdss-dsi-bllp-power-mode;
		qcom,mdss-dsi-lane-0-state;
		qcom,mdss-dsi-lane-1-state;
		qcom,mdss-dsi-lane-2-state;
		qcom,mdss-dsi-lane-3-state;
		qcom,mdss-dsi-dma-trigger = "trigger_sw";
		qcom,mdss-dsi-mdp-trigger = "none";
		qcom,mdss-dsi-reset-sequence = <1 10>, <0 10>, <1 10>;

		//qcom,mdss-dsi-te-pin-select = <1>;
		//qcom,mdss-dsi-te-dcs-command = <1>;
		//qcom,mdss-dsi-te-check-enable;
		//qcom,mdss-dsi-te-using-te-pin;
		//qcom,mdss-dsi-lp11-init;
		//qcom,mdss-dsi-wr-mem-start = <0x2c>;
		//qcom,mdss-dsi-wr-mem-continue = <0x3c>;
		//qcom,mdss-dsi-panel-hdr-enabled;
		//qcom,mdss-dsi-panel-hdr-color-primaries = <15635 16450 34000 16000 13250 34500 7500 3000>;
		qcom,mdss-dsi-panel-peak-brightness = <5400000>;
		qcom,mdss-dsi-panel-blackness-level = <2000>;
		qcom,mdss-pan-physical-width-dimension = <70>;
		qcom,mdss-pan-physical-height-dimension = <155>;
		//qcom,esd-check-enabled;
		//qcom,mdss-dsi-panel-status-check-mode = "reg_read";
		//qcom,mdss-dsi-panel-status-command = [06 01 00 01 05 00 01 0A];
		//qcom,mdss-dsi-panel-status-command-state = "dsi_lp_mode";
		//qcom,mdss-dsi-panel-status-value = <0x9C>;
		//qcom,mdss-dsi-panel-status-read-length = <1>;
		//qcom,dynamic-mode-switch-enabled;
		//qcom,dynamic-mode-switch-type = "dynamic-resolution-switch-immediate";
		qcom,mdss-dsi-display-timings {
			timing@0 {
				qcom,mdss-dsi-panel-framerate = <120>;
				qcom,mdss-dsi-panel-clockrate = <961000000>;
				qcom,mdss-dsi-panel-width = <1080>;
				qcom,mdss-dsi-panel-height = <2412>;
				qcom,mdss-dsi-h-front-porch = <50>;
				qcom,mdss-dsi-h-back-porch = <40>;
				qcom,mdss-dsi-h-pulse-width = <10>;
				qcom,mdss-dsi-h-sync-skew = <0>;
				qcom,mdss-dsi-h-sync-pulse = <0>;
				qcom,mdss-dsi-v-back-porch = <9>;
				qcom,mdss-dsi-v-front-porch = <21>;
				qcom,mdss-dsi-v-pulse-width = <2>;
				qcom,mdss-dsi-h-left-border = <0>;
				qcom,mdss-dsi-h-right-border = <0>;
				qcom,mdss-dsi-v-top-border = <0>;
				qcom,mdss-dsi-v-bottom-border = <0>;
				qcom,mdss-dsi-panel-jitter = <0x4 0x1>;

				oplus,fod-on-vblank = <0>;
				oplus,fod-off-vblank = <3>;
				qcom,mdss-dsi-timing-switch-command = [
					//120HZ
					39 01 00 00 00 00 04 FF 78 38 02
					39 01 00 00 00 00 02 38 11
					39 01 00 00 00 00 04 FF 78 38 00
				];
				qcom,mdss-dsi-on-command = [
					//Sleep out
					05 01 00 00 79 00 01 11
					05 01 00 00 00 00 01 29
				];
				qcom,mdss-dsi-off-command= [
					05 01 00 00 0B 00 01 28
					05 01 00 00 79 00 01 10];
				qcom,mdss-dsi-post-on-backlight = [
					/* Display On */

				];
				qcom,mdss-dsi-hbm-on-command = [
					//hbm
					39 01 00 00 11 00 02 53 20
					39 01 00 00 00 00 03 51 0F FF
				];
				qcom,mdss-dsi-normal-hbm-on-command = [
					//hbm
					39 01 00 00 11 00 02 53 20
					39 01 00 00 00 00 03 51 0F FF
				];
				qcom,mdss-dsi-hbm-off-command = [
					39 01 00 00 02 00 02 53 20
				];
				qcom,mdss-dsi-aod-hbm-on-command = [

				];
				qcom,mdss-dsi-aod-hbm-off-command = [

				];
				qcom,mdss-dsi-aod-high-mode-command = [
					39 01 00 00 00 00 04 FF 78 38 00
					39 01 00 00 00 00 02 39 00
					39 01 00 00 00 00 04 FF 78 38 0C
					39 01 00 00 00 00 02 BE 01
				];
				qcom,mdss-dsi-aod-low-mode-command = [
					39 01 00 00 00 00 04 FF 78 38 00
					39 01 00 00 00 00 02 39 00
					39 01 00 00 00 00 04 FF 78 38 0C
					39 01 00 00 00 00 02 BE 00
				];
				qcom,mdss-dsi-lp1-command = [
					//AOD ON
					39 01 00 00 00 00 04 FF 78 38 00
					39 01 00 00 00 00 02 39 00
					39 01 00 00 00 00 04 FF 78 38 0C
					39 01 00 00 00 00 02 BE 01
				];
				qcom,mdss-dsi-nolp-command = [
					//AOD OFF
					39 01 00 00 00 00 04 FF 78 38 00
					39 01 00 00 00 00 02 38 00
				];
				//qcom,mdss-dsi-seed-off-command = [

				//];
				//qcom,mdss-dsi-seed-3-command = [

				//];
				//qcom,mdss-dsi-seed-2-command = [

				//];
				//qcom,mdss-dsi-seed-1-command = [

				//];
				//qcom,mdss-dsi-seed-0-command = [

				//];
				qcom,mdss-dsi-hbm-enter-switch-command = [
					39 01 00 00 00 00 03 51 0D BB
				];
				qcom,mdss-dsi-hbm-exit-switch-command = [
					39 01 00 00 00 00 03 51 0D BB
				];
				qcom,mdss-dsi-osc-clk-mode0-command = [

				];
				qcom,mdss-dsi-osc-clk-mode1-command = [

				];
				qcom,mdss-dsi-timing-switch-command-state = "dsi_hs_mode";
				qcom,mdss-dsi-on-command-state = "dsi_lp_mode";
				qcom,mdss-dsi-off-command-state = "dsi_hs_mode";
				qcom,mdss-dsi-hbm-on-command-state = "dsi_hs_mode";
				qcom,mdss-dsi-hbm-off-command-state = "dsi_hs_mode";
				qcom,mdss-dsi-osc-clk-mode0-command-state = "dsi_hs_mode";
				qcom,mdss-dsi-osc-clk-mode1-command-state = "dsi_hs_mode";
				//qcom,mdss-dsi-seed-0-command-state = "dsi_hs_mode";
				//qcom,mdss-dsi-seed-1-command-state = "dsi_hs_mode";
				//qcom,mdss-dsi-seed-2-command-state = "dsi_hs_mode";
				//qcom,mdss-dsi-seed-3-command-state = "dsi_hs_mode";
				//qcom,mdss-dsi-seed-off-command-state = "dsi_hs_mode";
				qcom,compression-mode = "dsc";
				qcom,mdss-dsc-slice-height = <12>;
				qcom,mdss-dsc-slice-width = <540>;
				qcom,mdss-dsc-slice-per-pkt = <2>;
				qcom,mdss-dsc-bit-per-component = <8>;
				qcom,mdss-dsc-bit-per-pixel = <8>;
				qcom,mdss-dsc-block-prediction-enable;
				qcom,mdss-dsc-version = <0x11>;
			};
		};
	};
};

&dsi_oplus_virtual_video {
	qcom,panel-supply-entries = <&dsi_panel_oplus_pwr_supply_coffee>;
	qcom,mdss-dsi-panel-controller = <&mdss_dsi0>;
	qcom,mdss-dsi-bl-pmic-control-type = "bl_ctrl_dcs";
	qcom,mdss-dsi-bl-inverted-dbv;
	qcom,mdss-dsi-bl-min-level = <1>;
	qcom,mdss-dsi-bl-max-level = <4095>;
	qcom,mdss-brightness-max-level = <4095>;
	oplus,dsi-bl-normal-max-level = <3515>;
	oplus,dsi-brightness-normal-max-level = <3515>;
	oplus,dsi-brightness-default-level = <400>;
	qcom,platform-te-gpio = <&tlmm 99 0>;
	qcom,platform-reset-gpio = <&tlmm 98 0>;
	//qcom,ulps-enabled;
	qcom,dsi-select-clocks = "pll_byte_clk0", "pll_dsi_clk0";

	qcom,mdss-dsi-display-timings {
		timing@0 {
				qcom,mdss-dsi-panel-phy-timings = [00 1C 07 07 17 15 07 07 08 02 04 00 18 0C];
				qcom,display-topology = <1 1 1>;
				qcom,default-topology-index = <0>;
		};
	};
};

&dsi_oplus_virtual_video {
	qcom,panel_voltage_vddi_name = "vddio";
	qcom,panel_voltage_vddi = <0 1800000 1850000 1950000>;
	qcom,panel_voltage_vddr_name = "vddio";
	qcom,panel_voltage_vddr = <1 1800000 1850000 1950000>;
};
