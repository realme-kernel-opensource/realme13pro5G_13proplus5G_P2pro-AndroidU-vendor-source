/dts-v1/;
/plugin/;

#include <dt-bindings/clock/qcom,gcc-parrot.h>
#include <dt-bindings/clock/qcom,camcc-parrot.h>
#include <dt-bindings/interconnect/qcom,parrot.h>
#include <dt-bindings/interrupt-controller/arm-gic.h>
#include <dt-bindings/regulator/qcom,rpmh-regulator-levels.h>

#include <dt-bindings/oplus/hw-id.h>
#include "coffee-23611_camera-overlay-common.dtsi"
/ {
	model = "Qualcomm Technologies, Inc. Parrot QRD";
	compatible = "qcom,parrot";
	oplus,project-id = <23611 23682 23683>;
	qcom,msm-id = <537 0x10000>, <583 0x10000>, <613 0x10000>;
	qcom,board-id = <0x1000B 0>, <0x1000B 1>, <0x1000B 0x600>, <0x1000B 0x601>;
};
