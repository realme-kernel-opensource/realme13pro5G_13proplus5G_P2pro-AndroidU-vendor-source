/dts-v1/;
/plugin/;
#include <dt-bindings/oplus/hw-id.h>
#include "../parrot-audio-qrd-wcn6750.dts"
#include "parrot_audio_overlay_common.dtsi"
#include "amber-23619-audio-parrot-overlay_common.dtsi"
/ {
    oplus,project-id = <23619 23725 23726>;
//    oplus,hw-id = <OPLUS_EVB1 OPLUS_EVB2 OPLUS_T0 OPLUS_EVT1 OPLUS_EVT2 OPLUS_EVT3 OPLUS_DVT1 OPLUS_DVT2 OPLUS_DVT3 OPLUS_PVT1 OPLUS_MP1 OPLUS_MP2 OPLUS_MP3>;
};